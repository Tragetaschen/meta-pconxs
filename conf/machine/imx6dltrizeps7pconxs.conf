## conf/machine/imx6dltrizeps7pconxs.conf
```bitbake
#@TYPE: Machine
#@NAME: K&K i.MX6DL Trizeps 7 on a pConXS
#@SOC: i.MX6DL
#@DESCRIPTION: Machine configuration for K&K i.MX6DL Trizeps 7 on pConXS
#@MAINTAINER: Kai Ruhnau <kai.ruhnau@target-sg.com>

require conf/machine/include/imx6dltrizeps7.inc

KERNEL_DEVICETREE = "imx6dl-trizeps7-pconxs.dtb"
UBOOT_CONFIG[sd] = "mx6dltrizeps7pconxs_defconfig,sdcard"
```

## conf/machine/include/imx6dltrizeps7.inc
```bitbake
require conf/machine/include/imx-base.inc
require conf/machine/include/tune-cortexa9.inc

PREFERRED_PROVIDER_virtual/kernel = "linux-stable"
#PREFERRED_PROVIDER_virtual/kernel = "linux-fslc"
PREFERRED_PROVIDER_virtual/bootloader = "u-boot-fslc"

SERIAL_CONSOLE = "115200 ttymxc1"
SOC_FAMILY = "mx6:mx6dl"

KERNEL_IMAGETYPE = "zImage"

UBOOT_CONFIG = "sd"

MACHINE_FEATURES = "apm usbgadget usbhost vfat"
```
